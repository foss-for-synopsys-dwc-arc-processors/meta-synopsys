## conf/bblayers.conf.sample
```bitbake
# LAYER_CONF_VERSION is increased each time build/conf/bblayers.conf
# changes incompatibly
LCONF_VERSION = "7"

BBPATH = "${TOPDIR}"
BBFILES ?= ""

BBLAYERS ?= " \
  ##OEROOT##/meta \
  ##OEROOT##/../meta-synopsys \
  ##OEROOT##/../meta-openembedded/meta-oe \
  ##OEROOT##/../meta-openembedded/meta-networking \
  ##OEROOT##/../meta-openembedded/meta-python \
  "
```

## conf/distro/include/tclibc-uclibc.inc
```bitbake
#
# glibc specific configuration
#

#LIBCEXTENSION = "-glibc"

#LIBCOVERRIDE = ":libc-glibc"
#OVERRIDES .= "${LIBCOVERRIDE}"

PREFERRED_PROVIDER_virtual/libc ?= "glibc"
PREFERRED_PROVIDER_virtual/libiconv ?= "glibc"
PREFERRED_PROVIDER_virtual/libintl ?= "gettext"
PREFERRED_PROVIDER_virtual/nativesdk-libintl ?= "nativesdk-glibc"
PREFERRED_PROVIDER_virtual/nativesdk-libiconv ?= "nativesdk-glibc"

USE_NLS ?= "no"

CXXFLAGS += "-fvisibility-inlines-hidden"

IMAGE_LINGUAS = ""

LIBC_DEPENDENCIES = "\
    glibc \
    glibc-dbg \
    glibc-dev \
    glibc-thread-db \
    "
```

## conf/distro/include/tcmode-synopsys-arc.inc
```bitbake
#
# Synopsys ARC toolchain configuration
#

require conf/distro/include/tcmode-default.inc

GCCVERSION = "arc-7.1.1"
SDKGCCVERSION = "${GCCVERSION}"
BINUVERSION = "arc-2.28"
GDBVERSION = "arc-7.12%"
LINUXLIBCVERSION = "4.10%"
GLIBCVERSION = "arc-2017-09"
```

## conf/distro/snps-arc64-minimal.conf
```bitbake
DISTRO_NAME = "Synopsys minimal ramdisk"
DISTRO_VERSION = "0.1"
TARGET_VENDOR = "-snps"

VIRTUAL-RUNTIME_dev_manager = "busybox-mdev"
VIRTUAL-RUNTIME_login_manager = "busybox"
VIRTUAL-RUNTIME_init_manager = "busybox"
VIRTUAL-RUNTIME_base-utils = "busybox"

PREFERRED_PROVIDER_virtual/kernel = "linux-arc64-dev"

GCCVERSION = "arc"
SDKGCCVERSION = "${GCCVERSION}"
BINUVERSION = "arc"
GDBVERSION = "arc"
GLIBCVERSION = "arc64"
```

## conf/distro/synopsys.conf
```bitbake
# Distribution for ARC support

DISTRO_NAME = "synopsys"
DISTRO_VERSION = "1.0"

TCLIBC = "uclibc"
TCMODE = "synopsys-arc"

DISTRO_FEATURES = "${DISTRO_FEATURES_DEFAULT} ${DISTRO_FEATURES_LIBC}"

# Whitelist non-commercial to build some packages such as netperf
LICENSE_FLAGS_WHITELIST += "non-commercial"
```

## conf/layer.conf
```bitbake
# We have a conf and classes directory, add to BBPATH
BBPATH .= ":${LAYERDIR}"

# We have recipes-* directories, add to BBFILES
BBFILES += "${LAYERDIR}/recipes-*/*/*.bb ${LAYERDIR}/recipes-*/*/*.bbappend"

BBFILE_COLLECTIONS += "synopsys-layer"
BBFILE_PATTERN_synopsys-layer = "^${LAYERDIR}/"
BBFILE_PRIORITY_synopsys-layer = "6"

LAYERSERIES_COMPAT_synopsys-layer = "sumo thud zeus"

TOOLCHAIN_arc = "gcc"
```

## conf/machine/axs101.conf
```bitbake
require conf/machine/include/tune-arcompact.inc

SERIAL_CONSOLE = "115200 ttyS3"

KERNEL_IMAGETYPE = "uImage"

WKS_FILE ?= "sdimage-bootpart.wks"
IMAGE_FSTYPES += "wic"
IMAGE_BOOT_FILES ?= "uImage"
```

## conf/machine/axs103.conf
```bitbake
require conf/machine/include/arcv2-tune.inc

SERIAL_CONSOLES = "115200;ttyS3"

KERNEL_IMAGETYPE = "uImage"

WKS_FILE ?= "sdimage-bootpart.wks"
IMAGE_FSTYPES += "wic"
IMAGE_BOOT_FILES ?= "uImage"
```

## conf/machine/hapshs.conf
```bitbake
require conf/machine/include/tune-arcv2.inc

SERIAL_CONSOLES = "115200;ttyS0"

KERNEL_IMAGETYPE = "vmlinux"
KERNEL_OUTPUT_DIR = "."

IMAGE_FSTYPES += "${INITRAMFS_FSTYPES}"
INITRAMFS_IMAGE ?= "core-image-minimal"
INITRAMFS_IMAGE_BUNDLE = "1"
```

## conf/machine/hapshs6x.conf
```bitbake
DEFAULTTUNE = "hs68"

require conf/machine/include/tune-arcv3.inc

SERIAL_CONSOLES = "115200;ttyS0"

KERNEL_IMAGETYPE = "loader"

IMAGE_FSTYPES += "${INITRAMFS_FSTYPES}"
INITRAMFS_IMAGE ?= "core-image-minimal"
INITRAMFS_IMAGE_BUNDLE = "1"
```

## conf/machine/hsdk.conf
```bitbake
require conf/machine/include/tune-arcv2.inc

SERIAL_CONSOLES = "115200;ttyS0"

KERNEL_IMAGETYPE = "uImage"

WKS_FILE ?= "sdimage-bootpart.wks"
IMAGE_FSTYPES += "wic"
IMAGE_BOOT_FILES ?= "uImage uboot.env"
IMAGE_INSTALL:append += " u-boot"

UBOOT_MACHINE ?= "hsdk_defconfig"

UBOOT_ENV = "uboot"
UBOOT_ENV_SUFFIX = "env"

DEFAULTTUNE ?= "hs38_linux"
```

## conf/machine/include/arch-arc.inc
```bitbake
TUNEVALID[bigendian] = "Enable big-endian mode"

TUNE_ARCH = "${@bb.utils.contains('TUNE_FEATURES', 'bigendian', 'arceb', 'arc', d)}"

MACHINE_FEATURES_BACKFILL_CONSIDERED:append = " qemu-usermode"

PREFERRED_PROVIDER_virtual/kernel ?= "linux-arc"

# Otherwise huge binaries (>32MiB) might fail to link due to
# limitation of 25-bit R_ARC_S25H_PCREL_PLT relocation
GLIBC_EXTRA_OECONF_arc += " --with-nonshared-cflags=-mlong-calls"
```

## conf/machine/include/arcv2-tune.inc
```bitbake
require arch-arc.inc

DEFAULTTUNE ?= "archs"
TUNE_PKGARCH = "${TUNE_PKGARCH_tune-${DEFAULTTUNE}}"

TUNEVALID[hs] = "Enable ARC HS core with 32-bit atomic ops"
TUNE_CCARGS .= "${@bb.utils.contains('TUNE_FEATURES', 'hs', ' -mcpu=hs', '', d)}"

TUNEVALID[llsc64] = "Enable 64-bit LL/SC operations"
TUNE_CCARGS .= "${@bb.utils.contains('TUNE_FEATURES', 'llsc64', ' -mll64', '', d)}"

TUNEVALID[div_rem] = "Enable simple divider"
TUNE_CCARGS .= "${@bb.utils.contains('TUNE_FEATURES', 'div_rem', ' -mdiv-rem', '', d)}"

TUNEVALID[mpy] = "Enable simple hardware multiplier"
TUNE_CCARGS .= "${@bb.utils.contains('TUNE_FEATURES', 'mpy', ' -mmpy-option=mpy', '', d)}"

TUNEVALID[plus_qmacw] = "Enable most powerful hardware multiplier"
TUNE_CCARGS .= "${@bb.utils.contains('TUNE_FEATURES', 'plus_qmacw', ' -mmpy-option=plus_qmacw', '', d)}"

TUNEVALID[fpud_all] = "Enable double-precision FPU"
TUNE_CCARGS .= "${@bb.utils.contains('TUNE_FEATURES', 'fpud_all', ' -mfpu=fpud_all', '', d)}"

AVAILTUNES += "archs hs38 hs38linux"

TUNE_FEATURES_tune-archs = "hs llsc64 mpy"
TUNE_PKGARCH_tune-archs = "archs"
PACKAGE_EXTRA_ARCHS_tune-archs = "archs hs38 hs38linux"

TUNE_FEATURES_tune-hs38 = "hs llsc64 plus_qmacw"
TUNE_PKGARCH_tune-hs38 = "hs38"
PACKAGE_EXTRA_ARCHS_tune-hs38 = "hs38 hs38linux"

TUNE_FEATURES_tune-hs38linux = "hs llsc64 plus_qmacw fpud_all"
TUNE_PKGARCH_tune-hs38linux = "hs38linux"
PACKAGE_EXTRA_ARCHS_tune-hs38linux = "hs38linux"

def arc_machine_dict(machdata, d):
    machdata = {
            "elf" : {
                        "arc" :       (195,    0,    0,          True,          32),
                        "arceb" :     (195,    0,    0,          False,         32),
                      },
            "linux" : {
                        "arc" :       (195,    0,    0,          True,          32),
                        "arceb" :     (195,    0,    0,          False,         32),
                      },
    }
    return machdata

PACKAGEQA_EXTRA_MACHDEFFUNCS = "arc_machine_dict"
```

## conf/machine/include/tune-arcompact.inc
```bitbake
require arch-arc.inc

DEFAULTTUNE ?= "arc770"
TUNE_PKGARCH = "${TUNE_PKGARCH_tune-${DEFAULTTUNE}}"

TUNEVALID[arc750] = "Standard ARComact ARC750 core"
TUNE_CCARGS .= "${@bb.utils.contains('TUNE_FEATURES', 'arc700', ' -mcpu=arc700', '', d)}"

TUNEVALID[llsc] = "Use load-locked/store-conditional instructions"
TUNE_CCARGS .= "${@bb.utils.contains('TUNE_FEATURES', 'llsc', ' -matomic', '', d)}"

TUNEVALID[swape] = "Use endian swap instruction"
TUNE_CCARGS .= "${@bb.utils.contains('TUNE_FEATURES', 'swape', ' -mswape', '', d)}"

AVAILTUNES += "arc750 arc770"

TUNE_FEATURES_tune-arc750 = "arc750"
TUNE_PKGARCH_tune-arc750 = "arc750"
PACKAGE_EXTRA_ARCHS_tune-arc750 = "arc750 arc770"

TUNE_FEATURES_tune-arc770 = "arc750 llsc swape"
TUNE_PKGARCH_tune-arc770 = "arc770"
PACKAGE_EXTRA_ARCHS_tune-arc770 = "arc770"

def arc_machine_dict(machdata, d):
    machdata["linux-uclibc"] = {
                                 "arc" :   ( 93, 0, 0, True,  32),
                                 "arceb" : ( 93, 0, 0, False, 32),
                               }
    return machdata

PACKAGEQA_EXTRA_MACHDEFFUNCS = "arc_machine_dict"
```

## conf/machine/include/tune-arcv2.inc
```bitbake
require arch-arc.inc

DEFAULTTUNE ?= "archs"
TUNE_FEATURES += "arcv2"

TUNEVALID[hs] = "Enable ARC HS with atomic instructions"
TUNEVALID[hs34] = "Enable ARC HS with atomic and h/w multiplier instructions"
TUNEVALID[archs] = "Enable ARC HS generic CPU support"
TUNEVALID[hs38] = "Enable ARC HS full feature instructions"
TUNEVALID[hs38linux] = "Enable ARC HS full feature instructions and double-precision FPU"

TUNE_CCARGS_tune-hs = "-mcpu=hs"
TUNE_CCARGS_tune-hs34 = "-mcpu=hs34"
TUNE_CCARGS_tune-archs = "-mcpu=archs"
TUNE_CCARGS_tune-hs38 = "-mcpu=hs38"
TUNE_CCARGS_tune-hs38linux = "-mcpu=hs38_linux"

TUNE_FEATURES_tune-hs += "hs"
TUNE_FEATURES_tune-hs34 += "hs34"
TUNE_FEATURES_tune-archs += "archs"
TUNE_FEATURES_tune-hs38 += "hs38"
TUNE_FEATURES_tune-hs38linux += "hs38-fpu"
```

## conf/machine/include/tune-arcv3.inc
```bitbake
TUNE_ARCH = "${@bb.utils.contains('TUNE_FEATURES', 'hs58', 'arc32', 'arc64', d)}"

TUNE_PKGARCH = "${TUNE_PKGARCH_tune-${DEFAULTTUNE}}"

TUNEVALID[hs58] = "Enable ARCv3 64-bit"
TUNE_CCARGS .= "${@bb.utils.contains('TUNE_FEATURES', 'hs58', ' -mcpu=hs5x', '', d)}"

TUNEVALID[hs68] = "Enable ARCv3 64-bit core"
TUNE_CCARGS .= "${@bb.utils.contains('TUNE_FEATURES', 'hs68', ' -mcpu=hs6x', '', d)}"

TUNEVALID[ll64] = "Enable 64-bit load/store operations"
TUNE_CCARGS .= "${@bb.utils.contains('TUNE_FEATURES', 'll64', ' -mll64', '', d)}"

TUNEVALID[ll128] = "Enable 128-bit load/store operations"
TUNE_CCARGS .= "${@bb.utils.contains('TUNE_FEATURES', 'll128', ' -m128', ' -mno-128', d)}"

TUNEVALID[div_rem] = "Enable simple divider"
TUNE_CCARGS .= "${@bb.utils.contains('TUNE_FEATURES', 'div_rem', ' -mdiv-rem', ' -mno-div-rem', d)}"

AVAILTUNES += "hs58 hs68"

TUNE_FEATURES:tune-hs58 = "hs58 div_rem"
TUNE_PKGARCH_tune-hs58 = "hs58"
PACKAGE_EXTRA_ARCHS:tune-hs58 = "hs58"

TUNE_FEATURES:tune-hs68 = "hs68 ll128 div_rem"
TUNE_PKGARCH_tune-hs68 = "hs68"
PACKAGE_EXTRA_ARCHS:tune-hs68 = "hs68"

def arc_machine_dict(machdata, d):
    machdata = {
            "elf" : {
                        "arc32" :     (255,    0,    0,          True,          32),
                        "arc64" :     (253,    0,    0,          True,          64),
                      },
            "linux" : {
                        "arc32" :     (255,    0,    0,          True,          32),
                        "arc64" :     (253,    0,    0,          True,          64),
                      },
    }
    return machdata

PACKAGEQA_EXTRA_MACHDEFFUNCS = "arc_machine_dict"
```

## conf/machine/nsim700.conf
```bitbake
require conf/machine/include/tune-arcompact.inc

SERIAL_CONSOLE = "115200 ttyARC0"

KERNEL_IMAGETYPE = "vmlinux"
KERNEL_OUTPUT_DIR = "."
```

## conf/machine/nsimhs.conf
```bitbake
require conf/machine/include/arcv2-tune.inc

SERIAL_CONSOLES = "115200;ttyARC0"

KERNEL_IMAGETYPE = "vmlinux"
KERNEL_OUTPUT_DIR = "."

IMAGE_FSTYPES += "${INITRAMFS_FSTYPES}"
INITRAMFS_IMAGE ?= "core-image-minimal"
INITRAMFS_IMAGE_BUNDLE = "1"
```

## wic/sdimage-hsdk.wks
```
# short-description: Create HSDK SD card image
# long-description: Creates a partitioned SD card image for use with
# HSDK. Boot files are located in the first vfat partition.

part /boot --source bootimg-partition --ondisk mmcblk0 --fstype=vfat --label boot --active --align 4096 --size 20
part / --source rootfs --ondisk mmcblk0 --fstype=ext4 --label root --align 4096
```
